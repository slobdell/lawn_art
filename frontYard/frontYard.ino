/*
 * =====================================================================================
 *
 *       Filename:  current_teensy_sketch.c
 *
 *    Description:  :
 *
 *        Version:  1.0
 *        Created:  05/28/2016 20:18:05
 *       Revision:  none
 *       Compiler:  gcc
 *
 *         Author:  YOUR NAME (),
 *   Organization:
 *
 * ============b=========================================================================
 */



#include <OctoWS2811.h>
#include <stdio.h>

int INDICATOR_PIN = 13;
int BAUD_RATE = 115200;

byte pinstate=LOW;

const int WORD_LENGTH_BYTES = 3;
unsigned char CONTROL_HEADER[WORD_LENGTH_BYTES] = {255, 255, 255};

unsigned char controlIdentificationBuffer[WORD_LENGTH_BYTES] = {0, 0, 0};
unsigned char wordBuffer[WORD_LENGTH_BYTES] = {0, 0, 0};

int controlIdentificationIndex = WORD_LENGTH_BYTES - 1;
int wordIndex = WORD_LENGTH_BYTES - 1;

typedef int serialReadState;

const serialReadState READING_IMAGE = 0;
const serialReadState READING_FRAME_RATE = 1;
const serialReadState READING_WIDTH = 2;
const serialReadState READING_HEIGHT = 3;


serialReadState currentState = READING_IMAGE;

int cursorRow = 0;
int cursorCol = 0;


// likely to change, setting as a reasonable value for expressiveness
short frameWidth = 500;
short frameHeight = 8;

const int MAX_TEENSY_STRIPS = 8;

DMAMEM int *displayBuffer;
int *drawBuffer;

int BASE_R = 17;
int BASE_G = 10;
int BASE_B = 2;

char brightnessMatrix[288][48] = {
    { 0, 0, 0, 0, 0, 0, 0, 0, 0, 0, 0, 0, 0, 0, 0, 0, 0, 0, 0, 0, 0, 0, 0, 0, 0, 0, 0, 0, 0, 0, 0, 0, 0, 0, 0, 0, 0, 0, 0, 0, 0, 0, 0, 0, 0, 0, 0, 0, },
    { 0, 0, 0, 0, 0, 0, 0, 0, 0, 0, 0, 0, 0, 0, 0, 0, 0, 0, 0, 0, 0, 0, 0, 0, 0, 0, 0, 0, 0, 0, 0, 0, 0, 0, 0, 0, 0, 0, 0, 0, 0, 0, 0, 0, 0, 0, 0, 0, },
    { 0, 0, 0, 0, 0, 0, 0, 0, 0, 0, 0, 0, 0, 0, 0, 0, 0, 0, 0, 0, 0, 0, 0, 0, 0, 0, 0, 0, 0, 0, 0, 0, 0, 0, 0, 0, 0, 0, 0, 0, 0, 0, 0, 0, 0, 0, 0, 0, },
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    { 0, 0, 0, 0, 0, 0, 0, 0, 0, 0, 0, 0, 0, 0, 0, 0, 0, 0, 0, 0, 0, 0, 0, 0, 0, 0, 0, 0, 0, 0, 0, 0, 0, 0, 0, 0, 0, 0, 0, 0, 0, 0, 0, 0, 0, 0, 0, 0, },
};

// 91 x 2 bytes ==> 182 bytes
unsigned int isinTable16[] = { 
 0, 1144, 2287, 3430, 4571, 5712, 6850, 7987, 9121, 10252, 11380, 
 12505, 13625, 14742, 15854, 16962, 18064, 19161, 20251, 21336, 22414, 
 23486, 24550, 25607, 26655, 27696, 28729, 29752, 30767, 31772, 32768, 
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 64728, 64897, 65047, 65176, 65286, 65375, 65445, 65495, 65525, 65535, 
 }; 

// 91 bytes 
uint8_t isinTable8[] = { 
 0, 4, 9, 13, 18, 22, 27, 31, 35, 40, 44, 
 49, 53, 57, 62, 66, 70, 75, 79, 83, 87, 
 91, 96, 100, 104, 108, 112, 116, 120, 124, 128, 
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 252, 253, 253, 254, 254, 254, 255, 255, 255, 255, 
 }; 


float isin(long x)
{
 boolean pos = true;  // positive - keeps an eye on the sign.
 if (x < 0) 
 {
   x = -x;
   pos = !pos;  
 }  
 if (x >= 360) x %= 360;   
 if (x > 180) 
 {
   x -= 180;
   pos = !pos;
 }
 if (x > 90) x = 180 - x;
//  if (pos) return isinTable8[x] * 0.003921568627; // = /255.0
//  return isinTable8[x] * -0.003921568627 ;
 if (pos) return isinTable16[x] * 0.0000152590219; // = /65535.0
 return isinTable16[x] * -0.0000152590219 ;
}

float icos(long x)
{
 return isin(x+90);
}

float itan(long x) 
{
 return isin(x) / icos(x);
}

float fsin(float d)
{
 float a = isin(d);
 float b = isin(d+1);
 return a + (d-int(d)) * (b-a);
}


int *DOUG_WALL;
int *FRONT_WALL;
int *INNER_WALL;
int *FLOWER_BED;

int *STAIR0;
int *STAIR1;
int *STAIR2;
int *STAIR3;
int *STAIR4;

int STAIR0_LEN = 48 - 0;
int STAIR1_LEN = 95 - 48;
int STAIR2_LEN = 186 - 138;
int STAIR3_LEN = 138 - 95;
int STAIR4_LEN = 233 - 186;

int STAIR0_VIRTUAL_HEIGHT = 0;
int STAIR1_VIRTUAL_HEIGHT = 24;
int STAIR2_VIRTUAL_HEIGHT = 48;
int STAIR3_VIRTUAL_HEIGHT = 72;
int STAIR4_VIRTUAL_HEIGHT = 96;

void initializeArray(int *arr, int start_, int end_, bool reverse) {
  int cursorIndex = 0;
  //arr = new int[end_ - start_];
  if (reverse) {
    for(int i = end_; i >= 0; i--) {
      arr[cursorIndex] = i;
      cursorIndex++;
    } 
  } else {
    for(int i = start_; i < end_; i++) {
      arr[cursorIndex] = i;
      cursorIndex++;
    }  
  }  
}



int arrayLength(int *arr) {
  return sizeof(arr) / sizeof(arr[0]);
}

void initializeAddresses() {
  // Doug wall, row 0, up to col 149
  // very front wall, row 0 up to col 209
  // inner wall, row 0 up to col 350

  DOUG_WALL = new int[149 - 0];
  //initializeArray(DOUG_WALL, 0, 149, false);

  int cursorIndex = 0;
  DOUG_WALL = new int[149];
  for(int i = 0; i < 149; i++) {
    DOUG_WALL[cursorIndex] = i;
    cursorIndex++;
  }  

  cursorIndex = 0;
  INNER_WALL = new int[350];
  for(int i = 0; i < 350; i++) {
    INNER_WALL[cursorIndex] = i;
    cursorIndex++;
  }  

  cursorIndex = 0;
  STAIR0 = new int[48 - 0];
  for(int i = 0; i < 48; i++) {
    STAIR0[cursorIndex] = i;
    cursorIndex++;
  } 

  cursorIndex = 0;
  STAIR1 = new int[95 - 48];
  for(int i = 48; i < 95; i++) {
    STAIR1[cursorIndex] = i;
    cursorIndex++;
  } 

  cursorIndex = 0;
  STAIR2 = new int[186 - 138];
  for(int i = 186 - 1; i >= 138; i--) {
    STAIR2[cursorIndex] = i;
    cursorIndex++;
  } 

  cursorIndex = 0;
  STAIR3 = new int[138 - 95];
  for(int i = 138 - 1; i >= 95; i--) {
    STAIR3[cursorIndex] = i;
    cursorIndex++;
  }  

  cursorIndex = 0;
  STAIR4 = new int[233 - 186];
  for(int i = 186; i < 233; i++) {
    STAIR4[cursorIndex] = i;
    cursorIndex++;
  } 
    /*
  initializeArray(FRONT_WALL, 0, 209, false);
  initializeArray(INNER_WALL, 0, 350, false);

  // flower bed, row 1, up to col 230
  initializeArray(FLOWER_BED, 0, 230, false);

  // top stair 0, row 3, column up to 48
  // stair 1, col 48 t96
  // stair 3, 96 to 139
  // stair 2, 139 to 187
  // stair 4, 187 to 234

  initializeArray(STAIR0, 0, 48, false);
  initializeArray(STAIR1, 48, 96, false);
  initializeArray(STAIR2, 139, 187, true);
  initializeArray(STAIR3, 96, 139, true);
  initializeArray(STAIR4, 187, 234, false); 
  */
}


OctoWS2811 *getLedsInstance(short width_, short height_) {
  int totalLeds = width_ * height_;
  int ledsPerStrip = totalLeds / MAX_TEENSY_STRIPS;
  displayBuffer = (int *)malloc(ledsPerStrip * 6 * sizeof(int));
  drawBuffer = (int *)malloc(ledsPerStrip * 6 * sizeof(int));
  const int CONFIGURATION = WS2811_GRB | WS2811_800kHz; // might need to cange this value
  return new OctoWS2811 (
    ledsPerStrip,
    displayBuffer,
    drawBuffer,
    CONFIGURATION
  );
}

OctoWS2811 *leds = NULL;


short shortBytesToShort(unsigned char lsb, unsigned char msb) {
    return ((short) msb) << 8 | lsb;
}


unsigned int rbgToInt(unsigned char r, unsigned char b, unsigned char g) {
  return (
    ((unsigned int)r << 16) |
    ((unsigned int)g << 8) |
    (unsigned int)b
  );
}



void setup() {

    Serial.begin(BAUD_RATE);
    Serial.setTimeout(0);

    pinMode(2, OUTPUT);
    pinMode(3, OUTPUT);
    pinMode(INDICATOR_PIN, OUTPUT);
    digitalWrite(INDICATOR_PIN, HIGH);
    initializeAddresses();

    leds = getLedsInstance(frameWidth, frameHeight);
    leds->begin();
}


int BUFFER_SIZE = 512;
char *imageBuffer = (char *) malloc(BUFFER_SIZE);
int movingOffset = 0;
int loopCounter = 0;

void clearWithBase() {
  int basicColor;
  basicColor = rbgToInt(0, 0, 0);
  for(int r=0; r<frameHeight; r++) {
    for(int c=0; c<frameWidth; c++) {
      int movedCol = (movingOffset + c) % frameWidth;
      int pixelIndex = r * frameWidth;
      pixelIndex += movedCol;
      leds->setPixel(
        pixelIndex,
        basicColor
      );
    }
  }
}

void drawLights() {
  int baseColor = rbgToInt(BASE_R, BASE_B, BASE_G);

/*
  for(int r=0; r<frameHeight; r++) {
    for(int c=0; c<frameWidth; c++) {
      int movedCol = (movingOffset + c) % frameWidth;
      int pixelIndex = r * frameWidth + movedCol;
      int color = rbgToInt(BASE_R, BASE_B, BASE_G);
      leds->setPixel(
        pixelIndex,
        color
      );
    }
  }
  */
  


  // wall and flower bed
  for(int r=0; r<2; r++) {
    for(int i=0; i<350; i++) {
    int c = INNER_WALL[i];
    int pixelIndex = r * frameWidth + c;
    leds->setPixel(pixelIndex, baseColor);
    }
  }

  int r = 2;
  int baseR = 17;
  baseColor = rbgToInt(255, 0, 0);
  
  int heightsBottomToTop[5] = {
    STAIR4_VIRTUAL_HEIGHT,
    STAIR3_VIRTUAL_HEIGHT,
    STAIR2_VIRTUAL_HEIGHT,
    STAIR1_VIRTUAL_HEIGHT,
    STAIR0_VIRTUAL_HEIGHT,
  };

  int lengthsBottomToTop[5] = {
    STAIR4_LEN,
    STAIR3_LEN,
    STAIR2_LEN,
    STAIR1_LEN,
    STAIR0_LEN,
  };

  int *addressBottomToTop[5] = {
    STAIR4,
    STAIR3,
    STAIR2,
    STAIR1,
    STAIR0,
  };

  float speedController = 0.3;
  int IMAGE_HEIGHT = 288;

/*
  for(int i=0; i<STAIR4_LEN; i++) {
    int c = STAIR4[i];
    int pixelIndex = r * frameWidth + c;
          baseColor = rbgToInt(
        255,
        0,
        0
      );
      leds->setPixel(pixelIndex, baseColor);
  }
  */
  for(int stair=0; stair<5; stair++) {
    for(int i=0; i<lengthsBottomToTop[stair]; i++) {
      int c = addressBottomToTop[stair][i];
      int pixelIndex = r * frameWidth + c;
      baseColor = rbgToInt(
        BASE_R * brightnessMatrix[((heightsBottomToTop[stair] + (int)(loopCounter * speedController)) % IMAGE_HEIGHT)][i] / 1.5, 
        BASE_B * brightnessMatrix[((heightsBottomToTop[stair] + (int)(loopCounter * speedController)) % IMAGE_HEIGHT)][i] / 1.5, 
        BASE_G * brightnessMatrix[((heightsBottomToTop[stair] + (int)(loopCounter * speedController)) % IMAGE_HEIGHT)][i] / 1.5
      );
      leds->setPixel(pixelIndex, baseColor);
    }
  }


/*
  for(int i=0; i<lengthsBottomToTop[1]; i++) {
    int c = addressBottomToTop[1][i];
    int pixelIndex = r * frameWidth + c;
    baseColor = rbgToInt(BASE_R, BASE_B, BASE_G);
    leds->setPixel(pixelIndex, baseColor);
  }
  for(int i=0; i<lengthsBottomToTop[2]; i++) {
    int c = addressBottomToTop[2][i];
    int pixelIndex = r * frameWidth + c;
    baseColor = rbgToInt(BASE_R, BASE_B, BASE_G);
    leds->setPixel(pixelIndex, baseColor);
  }
  for(int i=0; i<lengthsBottomToTop[3]; i++) {
    int c = addressBottomToTop[3][i];
    int pixelIndex = r * frameWidth + c;
    baseColor = rbgToInt(BASE_R, BASE_B, BASE_G);
    leds->setPixel(pixelIndex, baseColor);
  }
  for(int i=0; i<lengthsBottomToTop[4]; i++) {
    int c = addressBottomToTop[4][i];
    int pixelIndex = r * frameWidth + c;
    baseColor = rbgToInt(BASE_R, BASE_B, BASE_G);
    leds->setPixel(pixelIndex, baseColor);
  }
  */
}

void loop() {
  loopCounter++;

  clearWithBase();
  drawLights();

  leds->show();
}

